## Kconfig
```kconfig
# Kconfig

mainmenu "Docker Runner Configuration Menu"

config HAVE_DOT_CONFIG
    bool
    default y

config NAME
    string "Container name"
    default "mycontainer"
    help
      The name of the container.

menu "Distribution Options"
    choice
        prompt "Base distribution"
        default DISTRO_archlinux
        config DISTRO_archlinux
            bool "Arch Linux"
            select PM_pacman
        config DISTRO_debian
            bool "Debian"
            select PM_apt
        config DISTRO_ubuntu
            bool "Ubuntu"
            select PM_apt
    endchoice

    config DISTRO
        string
        default "archlinux" if DISTRO_archlinux
        default "debian" if DISTRO_debian
        default "ubuntu" if DISTRO_ubuntu
        default "none"

    choice
        prompt "Base image"
        default IMAGE_archlinux
        config IMAGE_archlinux
            bool "archlinux"
            depends on DISTRO_archlinux
        config IMAGE_debian
            bool "debian"
            depends on DISTRO_debian
        config IMAGE_ubuntu
            bool "ubuntu"
            depends on DISTRO_ubuntu
    endchoice

    config IMAGE
        string
        default "archlinux" if DISTRO_archlinux
        default "debian" if DISTRO_debian
        default "ubuntu" if DISTRO_ubuntu
        default "none"

    choice
        prompt "Base image tag"
        default TAG_base
        config TAG_base
            bool "base"
            depends on IMAGE_archlinux
        config TAG_base_devel
            bool "base-devel"
            depends on IMAGE_archlinux
        config TAG_multilib_devel
            bool "multilib-devel"
            depends on IMAGE_archlinux
        config TAG_bookworm
            bool "12 bookworm"
            depends on IMAGE_debian
        config TAG_bullseye
            bool "11 bullseye"
            depends on IMAGE_debian
        config TAG_sid
            bool "sid"
            depends on IMAGE_debian
        config TAG_focal
            bool "20.04 focal"
            depends on IMAGE_ubuntu
        config TAG_jammy
            bool "22.04 jammy"
            depends on IMAGE_ubuntu
        config TAG_noble
            bool "24.04 noble"
            depends on IMAGE_ubuntu
    endchoice

    config TAG
        string
        default "base" if TAG_base
        default "base-devel" if TAG_base_devel
        default "multilib-devel" if TAG_multilib_devel
        default "bookworm" if TAG_bookworm
        default "bullseye" if TAG_bullseye
        default "sid" if TAG_sid
        default "focal" if TAG_focal
        default "jammy" if TAG_jammy
        default "noble" if TAG_noble
        default "latest"

    config PM_pacman
        bool "Use pacman as package manager"
        default y
        depends on DISTRO_archlinux
        help
            Use pacman package manager for Arch Linux.

    config PM_apt
        bool "Use apt as package manager"
        default y
        depends on DISTRO_debian || DISTRO_ubuntu
        help
            Use apt package manager for Debian or Ubuntu.

    config PM
        string
        default "pacman" if PM_pacman
        default "apt" if PM_apt
        default "none"

    config PM_INSTALL
        string 
        default "pacman -Syu --noconfirm --overwrite '*'" if PM_pacman
        default "apt update && apt upgrade -y" if PM_apt
        default "echo"

    config COPY_PACMAN_CONF
        bool "Copy pacman.conf to the container"
        default y
        depends on PM_pacman
        help
            Copy pacman.conf to the container.
    
    config COPY_PACMAN_MIRRORLIST
        bool "Copy pacman mirrorlist to the container"
        default y
        depends on PM_pacman
        help
            Copy pacman mirrorlist to the container.
    
    config COPY_APT_SOURCES_LIST
        bool "Copy apt sources.list to the container"
        default y
        depends on PM_apt
        help
            Copy apt sources.list to the container.
endmenu

menu "Docker Options"
    choice
        prompt "Network driver"
        default NETWORK_bridge
        config NETWORK_bridge
            bool "bridge"
        config NETWORK_host
            bool "host"
        config NETWORK_none
            bool "none"
    endchoice
    config NETWORK_DRIVER
        string
        default "bridge" if NETWORK_bridge
        default "host" if NETWORK_host
        default "none" if NETWORK_none

    config PORT_22
        bool "Expose port 22"
        default y
        help
            Expose port 22.
    config PORT_22_TO
        string "Map port 22 to host port"
        default "2222" if PORT_22
        depends on PORT_22

    config PORT_80
        bool "Expose port 80"
        default n
        help
            Expose port 80.
    config PORT_80_TO
        string "Map port 80 to host port"
        default "8080" if PORT_80
        depends on PORT_80
    
    config PORT_443
        bool "Expose port 443"
        default n
        help
            Expose port 443.
    config PORT_443_TO
        string "Map port 443 to host port"
        default "8443" if PORT_443
        depends on PORT_443

    config PORT_EXTRA
        string "Extra ports mappings"
        default ""
        help
            Extra ports to expose, delimited by space.

    config VOLUME_HOME
        bool "Create volume for /home"
        default y
        help
            Mount home directory.
    config VOLUME_HOME_TO
        string "Bind /home to host directory"
        default "./home" if VOLUME_HOME
        depends on VOLUME_HOME

    config VOLUME_ETC
        bool "Create volume for /etc"
        default n
        help
            Mount etc directory.
    config VOLUME_ETC_TO
        string "Bind /etc to host directory"
        default "./etc" if VOLUME_ETC
        depends on VOLUME_ETC

    config VOLUME_VAR
        bool "Create volume for /var"
        default n
        help
            Mount var directory.
    config VOLUME_VAR_TO
        string "Bind /var to host directory"
        default "./var" if VOLUME_VAR
        depends on VOLUME_VAR
    
    config VOLUME_SRV
        bool "Create volume for /srv"
        default n
        help
            Mount srv directory.
    config VOLUME_SRV_TO
        string "Bind /srv to host directory"
        default "./srv" if VOLUME_SRV
        depends on VOLUME_SRV
    
    config VOLUME_EXTRA
        string "Extra volumes"
        default ""
        help
            Extra volumes to mount, delimited by space.

    config HOSTS_LAB_MIRRORS
        bool "Add hosts for mirrors.lab.loongson.cn"
        default y
        help
            Add hosts for mirrors.lab.loongson.cn.

    config HOSTS_EXTRA
        string "Extra hosts entries"
        default ""
        help
            Extra hosts entries, delimited by space.

    config CAP_SYS_ADMIN
        bool "Add CAP_SYS_ADMIN capability"
        default n
        help
            Add CAP_SYS_ADMIN capability, allowing to mount filesystems.

    config CAP_PERFMON
        bool "Add CAP_PERFMON capability"
        default n
        help
            Add CAP_PERFMON capability, allowing to monitor performance counters.

    config CAP_EXTRA
        string "Extra capabilities"
        default ""
        help
            Extra capabilities, delimited by space.
    
    config CAP_PRIVILEGED
        bool "Run container in privileged mode"
        default n
        help
            Run container in privileged mode, allowing access to all devices.
endmenu


menu "Software Packages"
    comment "Shells"
        config PKG_USE_fish
            bool "fish"
            default y
            help
                Fish shell.
        config PKG_fish
            string
            default "fish"
            depends on PKG_USE_fish

        config PKG_USE_fisher
            bool "fisher"
            default y
            depends on PKG_USE_fish && DISTRO_archlinux
            help
                Fisher package manager for fish shell.
        config PKG_fisher
            string
            default "fisher"
            depends on PKG_USE_fisher

        config PKG_USE_zsh
            bool "zsh"
            default n
            help
                Zsh shell.
        config PKG_zsh
            string
            default "zsh"
            depends on PKG_USE_zsh

    
    comment "Editors"
        config PKG_USE_neovim
            bool "neovim"
            default y
            help
                Neovim text editor.
        config PKG_neovim
            string
            default "neovim"
            depends on PKG_USE_neovim
        
        config PKG_USE_vim
            bool "vim"
            default n
            help
                Vim text editor.
        config PKG_vim
            string
            default "vim"
            depends on PKG_USE_vim


    comment "Pagers"
        config PKG_USE_less        
            bool "less"
            default y
            help
                Less pager.
        config PKG_less
            string
            default "less"
            depends on PKG_USE_less


    comment "Version Control Systems"
        config PKG_USE_git
            bool "git"
            default y
            help
                Git version control system.
        config  PKG_git
            string
            default "git"
            depends on PKG_USE_git


    comment "Programming Languages & Compilers"
        config PKG_USE_python
            bool "python"
            default y
            help
                Python programming language.
        config PKG_python
            string
            default "python" if DISTRO_archlinux
            default "python3" if DISTRO_debian || DISTRO_ubuntu
            depends on PKG_USE_python
        
        config PKG_USE_gcc
            bool "gcc"
            default y
            help
                GNU Compiler Collection.
        config PKG_gcc
            string
            default "gcc"
            depends on PKG_USE_gcc
        
        config PKG_USE_clang
            bool "clang"
            default n
            help
                Clang compiler.
        config PKG_clang
            string
            default "clang"
            depends on PKG_USE_clang

    comment "Build tools"
        config PKG_USE_build_essential
            bool "build-essential"
            default y
            depends on DISTRO_debian || DISTRO_ubuntu
            help
                Build essential.
        config PKG_build_essential
            string
            default "build-essential"
            depends on PKG_USE_build_essential

        config PKG_USE_base_devel
            bool "base-devel"
            default y
            depends on DISTRO_archlinux
            help
                Base development tools.
        config PKG_base_devel
            string
            default "base-devel"
            depends on PKG_USE_base_devel

        config PKG_USE_cmake
            bool "cmake"
            default y
            help
                CMake build system.
        config PKG_cmake
            string
            default "cmake"
            depends on PKG_USE_cmake
        
        config PKG_USE_ninja
            bool "ninja"
            default y
            help
                Ninja build system.
        config PKG_ninja
            string
            default "ninja" if DISTRO_archlinux
            default "ninja-build" if DISTRO_debian || DISTRO_ubuntu
            depends on PKG_USE_ninja

        config PKG_USE_meson
            bool "meson"
            default n
            help
                Meson build system.
        config PKG_meson
            string
            default "meson"
            depends on PKG_USE_meson


    comment "Servers"
        config PKG_USE_openssh
            bool "openssh"
            default y
            help
                OpenSSH client and server.
        config PKG_openssh
            string 
            default "openssh" if DISTRO_archlinux
            default "openssh-client openssh-server" if DISTRO_debian || DISTRO_ubuntu
            depends on PKG_USE_openssh

    comment "Utilities"
        config PKG_USE_fdfind
            bool "fdfind"
            default y
            help
                Fd file finder.
        config PKG_fdfind
            string
            default "fd" if DISTRO_archlinux
            default "fd-find" if DISTRO_debian || DISTRO_ubuntu
            depends on PKG_USE_fdfind
        
        config PKG_USE_ripgrep
            bool "ripgrep"
            default y
            help
                Ripgrep search tool.
        config PKG_ripgrep
            string
            default "ripgrep"
            depends on PKG_USE_ripgrep

        config PKG_USE_ranger
            bool "ranger"
            default y
            help
                Ranger file manager.
        config PKG_ranger
            string
            default "ranger"
            depends on PKG_USE_ranger

        config PKG_USE_htop
            bool "htop"
            default y
            help
                Htop process viewer.
        config PKG_htop
            string
            default "htop"
            depends on PKG_USE_htop

        config PKG_USE_rsync
            bool "rsync"
            default y
            help
                Rsync file transfer utility.
        config PKG_rsync
            string
            default "rsync"
            depends on PKG_USE_rsync

        config PKG_USE_sudo
            bool "sudo"
            default y
            help
                Sudo privilege escalation.
        config PKG_sudo
            string
            default "sudo"
            depends on PKG_USE_sudo
endmenu


menu "User Options"
    config USER
        string "User name"
        default "user"
        help
            The user name.

    config CREATE_GROUP
        bool "Create group"
        default y
        help
            Create group for the user.
    config CREATE_GROUP_OPT
        string
        default "-U" if CREATE_GROUP
        default "-N"

    config CREATE_HOME
        bool "Create home directory"
        default y
        help
            Create home directory for the user.
    config CREATE_HOME_OPT
        string
        default "-m" if CREATE_HOME
        default "-M"

    config SUDO_ALLOW
        bool "Allow to use sudo"
        default y
        depends on PKG_USE_sudo
        help
            Allow the user to use sudo.
    config SUDO_NOPASSWD
        bool "Allow sudo without password"
        default y
        depends on SUDO_ALLOW
        help
            Allow the user to use sudo without password.


    config SH
        string "Shell"
        default "/usr/bin/fish" if PKG_USE_fish
        default "/usr/bin/zsh" if PKG_USE_zsh
        default "/bin/bash"
        help
            The shell.
endmenu
```
